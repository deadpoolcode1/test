/**
 * @cliArgs --board "/ti/boards/CC1352P_4_LAUNCHXL" --rtos "tirtos7" --product "simplelink_cc13xx_cc26xx_sdk@6.10.00.29"
 * @versions {"tool":"1.12.0+2406"}
 */

/**
 * Import the modules used in this configuration.
 */
const CCFG        = scripting.addModule("/ti/devices/CCFG");
const rfdesign    = scripting.addModule("/ti/devices/radioconfig/rfdesign");
const AESCCM      = scripting.addModule("/ti/drivers/AESCCM", {}, false);
const AESCCM1     = AESCCM.addInstance();
const GPIO        = scripting.addModule("/ti/drivers/GPIO");
const GPIO1       = GPIO.addInstance();
const GPIO2       = GPIO.addInstance();
const GPIO3       = GPIO.addInstance();
const GPIO4       = GPIO.addInstance();
const GPIO5       = GPIO.addInstance();
const GPIO6       = GPIO.addInstance();
const GPIO15      = GPIO.addInstance();
const NVS         = scripting.addModule("/ti/drivers/NVS");
const NVS1        = NVS.addInstance();
const NVS2        = NVS.addInstance();
const NVS3        = NVS.addInstance();
const NVS4        = NVS.addInstance();
const RF          = scripting.addModule("/ti/drivers/RF");
const Temperature = scripting.addModule("/ti/drivers/Temperature");
const UART        = scripting.addModule("/ti/drivers/UART", {}, false);
const UART1       = UART.addInstance();
const UART2       = UART.addInstance();
const Watchdog    = scripting.addModule("/ti/drivers/Watchdog", {}, false);
const Watchdog1   = Watchdog.addInstance();
const easylink    = scripting.addModule("/ti/easylink/easylink");
const Settings    = scripting.addModule("/ti/posix/tirtos/Settings");
const BIOS        = scripting.addModule("/ti/sysbios/BIOS");
const Event       = scripting.addModule("/ti/sysbios/knl/Event");
const Idle        = scripting.addModule("/ti/sysbios/knl/Idle", {}, false);
const Idle2       = Idle.addInstance();
const Mailbox     = scripting.addModule("/ti/sysbios/knl/Mailbox");
const Error       = scripting.addModule("/ti/sysbios/runtime/Error");
const SysCallback = scripting.addModule("/ti/sysbios/runtime/SysCallback");
const Timestamp   = scripting.addModule("/ti/sysbios/runtime/Timestamp");

/**
 * Write custom configuration values to the imported modules.
 */
CCFG.enableCodeGeneration = false;

rfdesign.rfDesign = "LAUNCHXL-CC1352P-4";

AESCCM1.$name = "CONFIG_AESCCM_0";

GPIO1.$hardware = system.deviceData.board.components.LED_RED;
GPIO1.$name     = "CONFIG_GPIO_RLED";

GPIO2.$hardware        = system.deviceData.board.components["BTN-1"];
GPIO2.$name            = "CONFIG_GPIO_BTN1";
GPIO2.pull             = "Pull Up";
GPIO2.interruptTrigger = "Both Edges";

GPIO3.$hardware        = system.deviceData.board.components["BTN-2"];
GPIO3.$name            = "CONFIG_GPIO_BTN2";
GPIO3.pull             = "Pull Up";
GPIO3.interruptTrigger = "Falling Edge";

GPIO4.$hardware = system.deviceData.board.components.LED_GREEN;
GPIO4.$name     = "CONFIG_GPIO_GLED";

GPIO5.$name           = "CONFIG_GPIO_TDD_SWITCH";
GPIO5.mode            = "Output";
GPIO5.gpioPin.$assign = "ball.43";
scripting.suppress("Connected to hardware,@@@.+?@@@ is connected to SKY13317-373LF RF Antenna Switch on the CC1352P-4 LaunchPad\. Consider selecting it in 'use hardware' above\. @@@.+?@@@", GPIO5, "gpioPin");

GPIO6.$name = "CONFIG_RJ_MAIN_LED1";
GPIO6.pull  = "Pull Up";

GPIO15.$name = "CONFIG_FPGA_CS";
GPIO15.mode  = "Output";

NVS1.$hardware                      = system.deviceData.board.components.MX25R8035F;
NVS1.$name                          = "OAD_NVS";
NVS1.externalFlash.$name            = "ti_drivers_nvs_NVSSPI25X0";
NVS1.externalFlash.verifyBufferSize = 64;
NVS1.externalFlash.regionSize       = 0x80000;

NVS2.$name                    = "FS_NVS_0";
NVS2.$hardware                = system.deviceData.board.components.MX25R8035F;
NVS2.externalFlash.$name      = "ti_drivers_nvs_NVSSPI25X1";
NVS2.externalFlash.regionBase = 0x80000;
NVS2.externalFlash.regionSize = 0x40000;

NVS3.$name                    = "ENV_NVS";
NVS3.$hardware                = system.deviceData.board.components.MX25R8035F;
NVS3.externalFlash.$name      = "ti_drivers_nvs_NVSSPI25X2";
NVS3.externalFlash.regionBase = 0xC0000;
NVS3.externalFlash.regionSize = 0x1000;

NVS4.$name                    = "THRESH_NVS";
NVS4.$hardware                = system.deviceData.board.components.MX25R8035F;
NVS4.externalFlash.$name      = "ti_drivers_nvs_NVSSPI25X3";
NVS4.externalFlash.regionBase = 0xC1000;
NVS4.externalFlash.regionSize = 0x1000;

scripting.suppress("The board 'CC1352P-4 LaunchPad' requires the 'RF Antenna Switch' to be selected\.", RF, "$hardware");
scripting.suppress("EasyLink stack requires the use of the RF Antenna Switch hardware", RF, "$hardware");

UART1.$hardware           = system.deviceData.board.components.XDS110UART;
UART1.$name               = "CONFIG_DISPLAY_UART";
UART1.txPinInstance.$name = "CONFIG_GPIO_1";
UART1.rxPinInstance.$name = "CONFIG_GPIO_2";

UART2.$name               = "CONFIG_UART_1";
UART2.uart.txPin.$assign  = "boosterpack.32";
UART2.uart.rxPin.$assign  = "boosterpack.31";
UART2.txPinInstance.$name = "CONFIG_GPIO_3";
UART2.rxPinInstance.$name = "CONFIG_GPIO_4";

Watchdog1.$name  = "CONFIG_WATCHDOG_0";
Watchdog1.period = 5000;

const NVSSPI25XDevice                         = scripting.addModule("/ti/drivers/nvs/NVSSPI25XDevice", {}, false);
const NVSSPI25XDevice1                        = NVSSPI25XDevice.addInstance({}, false);
NVS2.externalFlash.spiFlashDevice             = NVSSPI25XDevice1;
NVS3.externalFlash.spiFlashDevice             = NVSSPI25XDevice1;
NVS4.externalFlash.spiFlashDevice             = NVSSPI25XDevice1;
NVSSPI25XDevice1.$name                        = "CONFIG_NVS_SPI_0";
NVS1.externalFlash.spiFlashDevice             = NVSSPI25XDevice1;
NVSSPI25XDevice1.slaveSelectPinInstance.$name = "CONFIG_GPIO_0";

const SPI                          = scripting.addModule("/ti/drivers/SPI", {}, false);
const SPI1                         = SPI.addInstance({}, false);
NVSSPI25XDevice1.sharedSpiInstance = SPI1;
SPI1.$name                         = "Board_SPI_0";

easylink.rfDesign               = "LAUNCHXL-CC1352P-4";
easylink.enableOad              = true;
easylink.addrSize               = 8;
easylink.radioInactivityTimeout = 100000;
easylink.configInSrfStudio      = true;
easylink.oadModule.$name        = "ti_easylink_oad_config_easylink_oad_mod0";

BIOS.assertsEnabled = false;
BIOS.heapBaseAddr   = "__primary_heap_start__";
BIOS.heapEndAddr    = "__primary_heap_end__";

const Hwi           = scripting.addModule("/ti/sysbios/family/arm/m3/Hwi", {}, false);
Hwi.enableException = false;

const Clock      = scripting.addModule("/ti/sysbios/knl/Clock", {}, false);
Clock.tickPeriod = 10;

const Timer = scripting.addModule("/ti/sysbios/family/arm/cc26xx/Timer", {}, false);

Idle2.$name   = "powerIdle";
Idle2.idleFxn = "Power_idleFunc";

const Semaphore            = scripting.addModule("/ti/sysbios/knl/Semaphore", {}, false);
Semaphore.supportsPriority = false;

const Swi         = scripting.addModule("/ti/sysbios/knl/Swi", {}, false);
Swi.numPriorities = 6;

const Task             = scripting.addModule("/ti/sysbios/knl/Task", {}, false);
Task.defaultStackSize  = 512;
Task.idleTaskStackSize = 512;
Task.numPriorities     = 6;

Error.policy       = "Error_SPIN";
Error.printDetails = false;
Error.raiseHook    = "errorHandle";

const System           = scripting.addModule("/ti/sysbios/runtime/System", {}, false);
System.abortFxn        = "System_abortSpin";
System.exitFxn         = "System_exitSpin";
System.extendedFormats = "%f";
System.supportModule   = "SysCallback";

/**
 * Pinmux solution for unlocked pins/peripherals. This ensures that minor changes to the automatic solver in a future
 * version of the tool will not impact the pinmux you originally saw.  These lines can be completely deleted in order to
 * re-solve from scratch.
 */
GPIO1.gpioPin.$suggestSolution                = "boosterpack.39";
GPIO2.gpioPin.$suggestSolution                = "boosterpack.13";
GPIO3.gpioPin.$suggestSolution                = "boosterpack.8";
GPIO4.gpioPin.$suggestSolution                = "boosterpack.40";
GPIO6.gpioPin.$suggestSolution                = "boosterpack.10";
GPIO15.gpioPin.$suggestSolution               = "boosterpack.18";
UART1.uart.$suggestSolution                   = "UART1";
UART1.uart.txPin.$suggestSolution             = "boosterpack.4";
UART1.uart.rxPin.$suggestSolution             = "boosterpack.3";
UART2.uart.$suggestSolution                   = "UART0";
Watchdog1.watchdog.$suggestSolution           = "WDT0";
NVSSPI25XDevice1.slaveSelect.$suggestSolution = "boosterpack.38";
SPI1.spi.$suggestSolution                     = "SSI0";
SPI1.spi.sclkPin.$suggestSolution             = "boosterpack.7";
SPI1.spi.misoPin.$suggestSolution             = "boosterpack.14";
SPI1.spi.mosiPin.$suggestSolution             = "boosterpack.15";
SPI1.spi.dmaRxChannel.$suggestSolution        = "DMA_CH3";
SPI1.spi.dmaTxChannel.$suggestSolution        = "DMA_CH4";
Timer.rtc.$suggestSolution                    = "RTC0";
