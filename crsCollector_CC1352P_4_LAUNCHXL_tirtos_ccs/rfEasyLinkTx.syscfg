/**
 * @cliArgs --board "/ti/boards/CC1352P_4_LAUNCHXL" --product "simplelink_cc13x2_26x2_sdk@5.20.00.52"
 * @versions {"data":"2021060817","timestamp":"2021060817","tool":"1.8.2+1992","templates":null}
 */

/**
 * Import the modules used in this configuration.
 */
const CCFG     = scripting.addModule("/ti/devices/CCFG");
const rfdesign = scripting.addModule("/ti/devices/radioconfig/rfdesign");
const AESCCM   = scripting.addModule("/ti/drivers/AESCCM", {}, false);
const AESCCM1  = AESCCM.addInstance();
const GPIO     = scripting.addModule("/ti/drivers/GPIO");
const GPIO1    = GPIO.addInstance();
const GPIO2    = GPIO.addInstance();
const GPIO3    = GPIO.addInstance();
const GPIO4    = GPIO.addInstance();
const GPIO5    = GPIO.addInstance();
const NVS      = scripting.addModule("/ti/drivers/NVS", {}, false);
const NVS1     = NVS.addInstance();
const NVS2     = NVS.addInstance();
const RF       = scripting.addModule("/ti/drivers/RF");
const RTOS     = scripting.addModule("/ti/drivers/RTOS");
const UART     = scripting.addModule("/ti/drivers/UART", {}, false);
const UART1    = UART.addInstance();
const UART2    = UART.addInstance();
const easylink = scripting.addModule("/ti/easylink/easylink");

/**
 * Write custom configuration values to the imported modules.
 */
CCFG.xoscCapArray            = true;
CCFG.xoscCapArrayDelta       = 0xC1;
CCFG.enableBootloader        = true;
CCFG.dioBootloaderBackdoor   = 15;
CCFG.levelBootloaderBackdoor = "Active low";
CCFG.ccfgTemplate.$name      = "ti_devices_CCFGTemplate0";

rfdesign.rfDesign = "LAUNCHXL-CC1352P-4";

AESCCM1.$name = "CONFIG_AESCCM_0";

GPIO1.$hardware         = system.deviceData.board.components.LED_RED;
GPIO1.$name             = "CONFIG_GPIO_RLED";
GPIO1.pinInstance.$name = "CONFIG_PIN_RLED";

GPIO2.$hardware         = system.deviceData.board.components.LED_GREEN;
GPIO2.$name             = "CONFIG_GPIO_GLED";
GPIO2.pinInstance.$name = "CONFIG_PIN_GLED";

GPIO3.$name             = "CONFIG_RJ_MAIN_LED1";
GPIO3.pull              = "Pull Up";
GPIO3.gpioPin.$assign   = "boosterpack.10";
GPIO3.pinInstance.$name = "CONFIG_PIN_3";

GPIO4.$name             = "CONFIG_GPIO_BTN1";
GPIO4.$hardware         = system.deviceData.board.components["BTN-1"];
GPIO4.pinInstance.$name = "CONFIG_PIN_4";

GPIO5.$hardware         = system.deviceData.board.components["BTN-2"];
GPIO5.$name             = "CONFIG_GPIO_BTN2";
GPIO5.pinInstance.$name = "CONFIG_PIN_5";

NVS1.nvsType                  = "External";
NVS1.$hardware                = system.deviceData.board.components.MX25R8035F;
NVS1.$name                    = "CONFIG_NVSEXTERNAL";
NVS1.externalFlash.$name      = "ti_drivers_nvs_NVSSPI25X0";
NVS1.externalFlash.regionSize = 0x80000;

NVS2.$name                          = "CONFIG_NVS_0";
NVS2.$hardware                      = system.deviceData.board.components.MX25R8035F;
NVS2.externalFlash.$name            = "ti_drivers_nvs_NVSSPI25X1";
NVS2.externalFlash.regionBase       = 0x80000;
NVS2.externalFlash.regionSize       = 0x2000;
NVS2.externalFlash.verifyBufferSize = 200;

RF.$hardware = system.deviceData.board.components["SKY13317-373LF"];

UART1.$name               = "CONFIG_DISPLAY_UART";
UART1.$hardware           = system.deviceData.board.components.XDS110UART;
UART1.txPinInstance.$name = "CONFIG_PIN_0";
UART1.rxPinInstance.$name = "CONFIG_PIN_1";

UART2.$name               = "CONFIG_UART_1";
UART2.txPinInstance.$name = "CONFIG_PIN_9";
UART2.rxPinInstance.$name = "CONFIG_PIN_10";

const NVSSPI25XDevice                                      = scripting.addModule("/ti/drivers/nvs/NVSSPI25XDevice", {}, false);
const NVSSPI25XDevice1                                     = NVSSPI25XDevice.addInstance({}, false);
NVSSPI25XDevice1.$name                                     = "CONFIG_NVS_SPI_0";
NVS1.externalFlash.spiFlashDevice                          = NVSSPI25XDevice1;
NVS2.externalFlash.spiFlashDevice                          = NVSSPI25XDevice1;
NVSSPI25XDevice1.slaveSelectGpioInstance.$name             = "CONFIG_GPIO_0";
NVSSPI25XDevice1.slaveSelectGpioInstance.pinInstance.$name = "CONFIG_PIN_2";

const SPI                          = scripting.addModule("/ti/drivers/SPI", {}, false);
const SPI1                         = SPI.addInstance({}, false);
SPI1.$name                         = "CONFIG_SPI_0";
NVSSPI25XDevice1.sharedSpiInstance = SPI1;
SPI1.sclkPinInstance.$name         = "CONFIG_PIN_6";
SPI1.misoPinInstance.$name         = "CONFIG_PIN_7";
SPI1.mosiPinInstance.$name         = "CONFIG_PIN_8";

easylink.rfDesign          = "LAUNCHXL-CC1352P-4";
easylink.configInSrfStudio = true;
easylink.addrSize          = 8;

/**
 * Pinmux solution for unlocked pins/peripherals. This ensures that minor changes to the automatic solver in a future
 * version of the tool will not impact the pinmux you originally saw.  These lines can be completely deleted in order to
 * re-solve from scratch.
 */
GPIO1.gpioPin.$suggestSolution                                    = "boosterpack.39";
GPIO2.gpioPin.$suggestSolution                                    = "boosterpack.40";
GPIO4.gpioPin.$suggestSolution                                    = "boosterpack.13";
GPIO5.gpioPin.$suggestSolution                                    = "boosterpack.8";
RF.rfAntennaPin0.$suggestSolution                                 = "41";
RF.rfAntennaPin1.$suggestSolution                                 = "42";
RF.rfAntennaPin2.$suggestSolution                                 = "43";
UART1.uart.$suggestSolution                                       = "UART1";
UART1.uart.txPin.$suggestSolution                                 = "boosterpack.4";
UART1.uart.rxPin.$suggestSolution                                 = "boosterpack.3";
UART2.uart.$suggestSolution                                       = "UART0";
UART2.uart.txPin.$suggestSolution                                 = "boosterpack.32";
UART2.uart.rxPin.$suggestSolution                                 = "boosterpack.18";
NVSSPI25XDevice1.slaveSelectGpioInstance.gpioPin.$suggestSolution = "boosterpack.38";
SPI1.spi.$suggestSolution                                         = "SSI0";
SPI1.spi.sclkPin.$suggestSolution                                 = "boosterpack.7";
SPI1.spi.misoPin.$suggestSolution                                 = "boosterpack.14";
SPI1.spi.mosiPin.$suggestSolution                                 = "boosterpack.15";
SPI1.spi.dmaRxChannel.$suggestSolution                            = "DMA_CH3";
SPI1.spi.dmaTxChannel.$suggestSolution                            = "DMA_CH4";
